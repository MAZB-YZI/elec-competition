#include "ssd1306.h"
#include <string.h>

extern I2C_HandleTypeDef hi2c1;

static uint8_t SSD1306_Buffer[SSD1306_WIDTH * SSD1306_PAGES];

/* 6x8 ASCII font (0x20 - 0x7E) */
static const uint8_t Font6x8[][6] = {
    {0x00,0x00,0x00,0x00,0x00,0x00}, {0x00,0x00,0x5F,0x00,0x00,0x00},
    {0x00,0x07,0x00,0x07,0x00,0x00}, {0x14,0x7F,0x14,0x7F,0x14,0x00},
    {0x24,0x2A,0x7F,0x2A,0x12,0x00}, {0x23,0x13,0x08,0x64,0x62,0x00},
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    {0x08,0x04,0x08,0x10,0x08,0x00},
};

/* Recover a wedged I2C bus (noise/glitch on jumper wires can leave SDA
   held low → all transfers time out and the OLED appears frozen).
   Re-initialising the peripheral clears the BUSY/error state without a
   manual board reset. */
static void I2C_Recover(void)
{
    HAL_I2C_DeInit(&hi2c1);
    HAL_I2C_Init(&hi2c1);
}

static int I2C_Write(uint8_t ctrl, const uint8_t *data, uint16_t len)
{
    uint8_t buf[17];
    uint16_t pos = 0;

    while (pos < len) {
        uint16_t chunk = len - pos;
        if (chunk > 16) chunk = 16;
        buf[0] = ctrl;
        memcpy(buf + 1, data + pos, chunk);
        if (HAL_I2C_Master_Transmit(&hi2c1, SSD1306_ADDR, buf, chunk + 1, 20) != HAL_OK) {
            /* transfer failed — bus may be wedged; try to recover */
            I2C_Recover();
            return -1;
        }
        pos += chunk;
    }
    return 0;
}

static void I2C_WriteCmd(uint8_t cmd)
{
    I2C_Write(0x00, &cmd, 1);
}

void SSD1306_Init(void)
{
    HAL_Delay(100);

    I2C_WriteCmd(0xAE); /* display off */
    I2C_WriteCmd(0xD5); I2C_WriteCmd(0x80); /* clock div */
    I2C_WriteCmd(0xA8); I2C_WriteCmd(0x3F); /* mux ratio 64 */
    I2C_WriteCmd(0xD3); I2C_WriteCmd(0x00); /* display offset 0 */
    I2C_WriteCmd(0x40);                     /* start line 0 */
    I2C_WriteCmd(0x8D); I2C_WriteCmd(0x14); /* charge pump enable */
    I2C_WriteCmd(0x20); I2C_WriteCmd(0x02); /* page addressing mode */
    I2C_WriteCmd(0xA1);                     /* segment remap (left-right flip) */
    I2C_WriteCmd(0xC8);                     /* COM scan from COM[N-1] to COM0 */
    I2C_WriteCmd(0xDA); I2C_WriteCmd(0x12); /* COM pins alternative */
    I2C_WriteCmd(0x81); I2C_WriteCmd(0x7F); /* contrast */
    I2C_WriteCmd(0xD9); I2C_WriteCmd(0xF1); /* pre-charge period */
    I2C_WriteCmd(0xDB); I2C_WriteCmd(0x40); /* VCOMH deselect level */
    I2C_WriteCmd(0xA4);                     /* entire display resume */
    I2C_WriteCmd(0xA6);                     /* normal (non-inverted) display */

    SSD1306_Clear();
    SSD1306_UpdateScreen();

    I2C_WriteCmd(0xAF); /* display on */
}

void SSD1306_Clear(void)
{
    memset(SSD1306_Buffer, 0x00, sizeof(SSD1306_Buffer));
}

void SSD1306_UpdateScreen(void)
{
    for (uint8_t p = 0; p < SSD1306_PAGES; p++) {
        uint8_t cmds[] = {0xB0 | p, 0x00, 0x10};
        if (I2C_Write(0x00, cmds, 3) != 0) return;   /* bus wedged → bail,
                                          recovered for next frame */
        if (I2C_Write(0x40, &SSD1306_Buffer[p * SSD1306_WIDTH],
                      SSD1306_WIDTH) != 0) return;
    }
}

void SSD1306_DrawString(uint8_t page, uint8_t col, const char *str)
{
    if (page >= SSD1306_PAGES) return;

    while (*str) {
        if (col + 6 > SSD1306_WIDTH) break;
        if (*str < 0x20 || *str > 0x7E) { str++; continue; }

        const uint8_t *g = Font6x8[*str - 0x20];
        for (uint8_t i = 0; i < 6; i++) {
            SSD1306_Buffer[col + i + page * SSD1306_WIDTH] = g[i];
        }
        col += 6;
        str++;
    }
}
